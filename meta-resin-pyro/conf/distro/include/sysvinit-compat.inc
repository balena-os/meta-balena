## meta-resin-pyro/conf/layer.conf
```bitbake
# This layer was deprecated in the favor of resin-balena-pyro
BALENA_LAYERDIR := "${LAYERDIR}/../meta-balena-pyro"

BBPATH .= ":${BALENA_LAYERDIR}"

BBFILES += "${BALENA_LAYERDIR}/recipes-*/*/*.bb \
            ${BALENA_LAYERDIR}/recipes-*/*/*.bbappend"

BBFILE_COLLECTIONS += "resin-pyro"
BBFILE_PATTERN_resin-pyro := "^${BALENA_LAYERDIR}/"
BBFILE_PRIORITY_resin-pyro = "1337"
```

## meta-resin-raspberrypi/conf/layer.conf
```bitbake
BBPATH .= ":${LAYERDIR}"

BBFILES += "${LAYERDIR}/recipes-*/*/*.bb \
            ${LAYERDIR}/recipes-*/*/*.bbappend"

BBFILE_COLLECTIONS += "resin-raspberrypi"
BBFILE_PATTERN_resin-raspberrypi := "^${LAYERDIR}/"
BBFILE_PRIORITY_resin-raspberrypi = "1337"
```

## meta-resin-rocko/conf/distro/include/balena-os-yocto-version.inc
```bitbake
include conf/distro/include/security_flags.inc

PREFERRED_VERSION_tpm2-tss = "3.0.3"
DISTRO_FEATURES_DEFAULT_remove = "x11"
```

## meta-resin-rocko/conf/layer.conf
```bitbake
# This layer was deprecated in the favor of resin-balena-rocko
BALENA_LAYERDIR := "${LAYERDIR}/../meta-balena-rocko"

BBPATH .= ":${BALENA_LAYERDIR}"

BBFILES += "${BALENA_LAYERDIR}/recipes-*/*/*.bb \
            ${BALENA_LAYERDIR}/recipes-*/*/*.bbappend"

BBFILE_COLLECTIONS += "resin-rocko"
BBFILE_PATTERN_resin-rocko := "^${BALENA_LAYERDIR}/"
BBFILE_PRIORITY_resin-rocko = "1337"
```

## meta-resin-sumo/conf/distro/include/balena-os-yocto-version.inc
```bitbake
include conf/distro/include/security_flags.inc

PREFERRED_VERSION_rust = "1.36.0"
PREFERRED_VERSION_rust-native = "1.36.0"
PREFERRED_VERSION_rust-cross-${TARGET_ARCH} = "1.36.0"
PREFERRED_VERSION_rust-llvm-native = "1.36.0"
PREFERRED_VERSION_cargo-native = "1.36.0"
PREFERRED_VERSION_libstd-rs = "1.36.0"
PREFERRED_VERSION_libqmi = "1.26.0"
PREFERRED_VERSION_libmbim = "1.24.2"
```

## meta-resin-sumo/conf/layer.conf
```bitbake
BBPATH .= ":${LAYERDIR}"

BBFILES += "${LAYERDIR}/recipes-*/*/*.bb \
            ${LAYERDIR}/recipes-*/*/*.bbappend"

BBFILE_COLLECTIONS += "resin-sumo"
BBFILE_PATTERN_resin-sumo := "^${LAYERDIR}/"
BBFILE_PRIORITY_resin-sumo = "1337"

LAYERSERIES_COMPAT_resin-sumo = "sumo"

# balena-engine has a requirement of a newer go compile brought in this layer from yocto thud
GOVERSION = "1.12.12"
```

## meta-resin-toradex/conf/layer.conf
```bitbake
BBPATH .= ":${LAYERDIR}"

BBFILES += "${LAYERDIR}/recipes-*/*/*.bb \
            ${LAYERDIR}/recipes-*/*/*.bbappend"

BBFILE_COLLECTIONS += "resin-toradex"
BBFILE_PATTERN_resin-toradex := "^${LAYERDIR}/"
BBFILE_PRIORITY_resin-toradex = "1337"

# Mask recipes that we do not provide yet
BBMASK = "meta-toradex/recipes-qt/|meta-toradex/recipes-lxde/|meta-toradex/recipes-browser/|meta-toradex/recipes-mozilla/|meta-toradex/recipes-gnome|meta-toradex/recipes-fsl/packagegroups/|meta-toradex/recipes-support/florence|u-boot-toradex_2015.04|meta-toradex/recipes/trdx-config/|meta-toradex/recipes-core/psplash/psplash-angstrom_git"
```

## meta-resin-ts/conf/layer.conf
```bitbake
BBPATH .= ":${LAYERDIR}"

BBFILES += "${LAYERDIR}/recipes-*/*/*.bb \
            ${LAYERDIR}/recipes-*/*/*.bbappend"

BBFILE_COLLECTIONS += "resin-ts"
BBFILE_PATTERN_resin-ts := "^${LAYERDIR}/"
BBFILE_PRIORITY_resin-ts = "1337"

# Mask temporary the qt5 bbappends
BBMASK ?= ".*/meta-ts/recipes-qt/qt5/"
```

## meta-resin-ts/conf/machine/ts4900.conf
```bitbake
include conf/machine/tsimx6.conf

PREFERRED_PROVIDER_u-boot ?= "u-boot-ts"
PREFERRED_PROVIDER_virtual/bootloader = "u-boot-ts"

UBOOT_MACHINE = "ts4900-s-1g-800mhz-i_defconfig"
```

## meta-resin-ts/conf/machine/ts7700.conf
```bitbake
#@TYPE: Machine
#@NAME: Technologic Systems TS-7700 Board
#@SOC: Marvel PXA16x
#@DESCRIPTION: Machine configuration for PXA16x

include conf/machine/include/tune-arm926ejs.inc

PREFERRED_PROVIDER_virtual/kernel ?= "linux-pxa16x"
PREFERRED_VERSION_linux-pxa16x ?= "3.14"
PREFERRED_PROVIDER_virtual/bootloader ?= "mbr-pxa-bootstrap"

KERNEL_IMAGETYPE = "zImage"

hostname_pn-base-files = "ts-pxa"
```

## meta-resin-via-arm/conf/layer.conf
```bitbake
BBPATH .= ":${LAYERDIR}"

BBFILES += "${LAYERDIR}/recipes-*/*/*.bb \
            ${LAYERDIR}/recipes-*/*/*.bbappend"

BBFILE_COLLECTIONS += "resin-vab820"
BBFILE_PATTERN_resin-vab820 := "^${LAYERDIR}/"
BBFILE_PRIORITY_resin-vab820 = "1337"
```

## meta-resin-zc702/conf/layer.conf
```bitbake
BBPATH .= ":${LAYERDIR}"

BBFILES += "${LAYERDIR}/recipes-*/*/*.bb \
            ${LAYERDIR}/recipes-*/*/*.bbappend"

BBFILE_COLLECTIONS += "resin-zc702"
BBFILE_PATTERN_resin-zc702 := "^${LAYERDIR}/"
BBFILE_PRIORITY_resin-zc702 = "1337"
```
