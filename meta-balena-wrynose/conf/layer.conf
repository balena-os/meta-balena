## meta-balena-wrynose/conf/layer.conf
```bitbake
BBPATH .= ":${LAYERDIR}"

BBFILES += "${LAYERDIR}/recipes-*/*/*.bb \
            ${LAYERDIR}/recipes-*/*/*.bbappend"

BBFILE_COLLECTIONS += "balena-wrynose"
BBFILE_PATTERN_balena-wrynose := "^${LAYERDIR}/"
BBFILE_PRIORITY_balena-wrynose = "1337"

LAYERSERIES_COMPAT_balena-wrynose = "wrynose"
```

## meta-balena-zeus/conf/layer.conf
```bitbake
BBPATH .= ":${LAYERDIR}"

BBFILES += "${LAYERDIR}/recipes-*/*/*.bb \
            ${LAYERDIR}/recipes-*/*/*.bbappend"

BBFILE_COLLECTIONS += "balena-zeus"
BBFILE_PATTERN_balena-zeus := "^${LAYERDIR}/"
BBFILE_PRIORITY_balena-zeus = "1337"

LAYERSERIES_COMPAT_balena-zeus = "zeus"
```

## meta-resin-beaglebone/conf/bblayers.conf
```bitbake
# LAYER_CONF_VERSION is increased each time build/conf/bblayers.conf
# changes incompatibly
LCONF_VERSION = "6"

BBPATH = "${TOPDIR}"
BBFILES ?= ""

BBLAYERS ?= " \
  ${TOPDIR}/../poky/meta \
  ${TOPDIR}/../poky/meta-yocto \
  ${TOPDIR}/../meta-resin/meta-resin-beaglebone \
  ${TOPDIR}/../meta-resin/meta-resin-common \
  ${TOPDIR}/../meta-ti \
  ${TOPDIR}/../meta-openembedded/meta-oe \
  ${TOPDIR}/../meta-openembedded/meta-networking \
  ${TOPDIR}/../meta-openembedded/meta-python \
  "

BBLAYERS_NON_REMOVABLE ?= " \
  ${TOPDIR}/../poky/meta \
  ${TOPDIR}/../poky/meta-yocto \
  "
```

## meta-resin-beaglebone/conf/layer.conf
```bitbake
BBPATH .= ":${LAYERDIR}"

BBFILES += "${LAYERDIR}/recipes-*/*/*.bb \
            ${LAYERDIR}/recipes-*/*/*.bbappend"

BBFILE_COLLECTIONS += "resin-beaglebone"
BBFILE_PATTERN_resin-beaglebone := "^${LAYERDIR}/"
BBFILE_PRIORITY_resin-beaglebone = "1337"

LAYERDEPENDS_resin-beaglebone = "core"
LAYERDEPENDS_resin-beaglebone += "openembedded-layer"
LAYERDEPENDS_resin-beaglebone += "networking-layer"
LAYERDEPENDS_resin-beaglebone += "resin-common"
LAYERDEPENDS_resin-beaglebone += "resin-fido"
LAYERDEPENDS_resin-beaglebone += "meta-ti"

PREFERRED_PROVIDER_virtual/kernel_beaglebone = "linux-beagleboard"
```

## meta-resin-beaglebone/conf/local.conf
```bitbake
# Parallelism Options
#
# Default to setting automatically based on cpu count
BB_NUMBER_THREADS ?= "${@oe.utils.cpu_count()}"

# Default to setting automatically based on cpu count
PARALLEL_MAKE ?= "-j ${@oe.utils.cpu_count()}"

#
# Machine Selection
#
# You need to select a specific machine to target the build with. There are a selection
MACHINE ?= "beaglebone"

#
# Default policy config
#
# The distribution setting controls which policy settings are used as defaults.
# The default value is fine for general Yocto project use, at least initially.
# Ultimately when creating custom policy, people will likely end up subclassing 
# these defaults.
#
DISTRO ?= "resin"
# As an example of a subclass there is a "bleeding" edge policy configuration
# where many versions are set to the absolute latest code from the upstream 
# source control systems. This is just mentioned here as an example, its not
# useful to most new users.
# DISTRO ?= "poky-bleeding"

#
# Package Management configuration
#
# This variable lists which packaging formats to enable. Multiple package backends 
# can be enabled at once and the first item listed in the variable will be used 
# to generate the root filesystems.
# Options are:
#  - 'package_deb' for debian style deb files
#  - 'package_ipk' for ipk files are used by opkg (a debian style embedded package manager)
#  - 'package_rpm' for rpm style packages
# E.g.: PACKAGE_CLASSES ?= "package_rpm package_deb package_ipk"
# We default to rpm:

PACKAGE_CLASSES ?= "package_deb"

# Extra image configuration defaults
#
# The EXTRA_IMAGE_FEATURES variable allows extra packages to be added to the generated 
# images. Some of these options are added to certain image types automatically. The
# variable can contain the following options:
#  "dbg-pkgs"       - add -dbg packages for all installed packages
#                     (adds symbol information for debugging/profiling)
#  "dev-pkgs"       - add -dev packages for all installed packages
#                     (useful if you want to develop against libs in the image)
#  "ptest-pkgs"     - add -ptest packages for all ptest-enabled packages
#                     (useful if you want to run the package test suites)
#  "tools-sdk"      - add development tools (gcc, make, pkgconfig etc.)
#  "tools-debug"    - add debugging tools (gdb, strace)
#  "eclipse-debug"  - add Eclipse remote debugging support
#  "tools-profile"  - add profiling tools (oprofile, exmap, lttng, valgrind)
#  "tools-testapps" - add useful testing tools (ts_print, aplay, arecord etc.)
#  "debug-tweaks"   - make an image suitable for development
#                     e.g. ssh root access has a blank password
# There are other application targets that can be used here too, see
# meta/classes/image.bbclass and meta/classes/core-image.bbclass for more details.
# We default to enabling the debugging tweaks.
#EXTRA_IMAGE_FEATURES = "debug-tweaks"

#
# Additional image features
#
# The following is a list of additional classes to use when building images which
# enable extra features. Some available options which can be included in this variable 
# are:
#   - 'buildstats' collect build statistics
#   - 'image-mklibs' to reduce shared library files size for an image
#   - 'image-prelink' in order to prelink the filesystem image
#   - 'image-swab' to perform host system intrusion detection
# NOTE: if listing mklibs & prelink both, then make sure mklibs is before prelink
# NOTE: mklibs also needs to be explicitly enabled for a given image, see local.conf.extended
USER_CLASSES ?= "buildstats image-mklibs image-prelink"

# Interactive shell configuration
#
# Under certain circumstances the system may need input from you and to do this it 
# can launch an interactive shell. It needs to do this since the build is 
# multithreaded and needs to be able to handle the case where more than one parallel
# process may require the user's attention. The default is iterate over the available
# terminal types to find one that works.
#
# Examples of the occasions this may happen are when resolving patches which cannot
# be applied, to use the devshell or the kernel menuconfig
#
# Supported values are auto, gnome, xfce, rxvt, screen, konsole (KDE 3.x only), none
# Note: currently, Konsole support only works for KDE 3.x due to the way
# newer Konsole versions behave
#OE_TERMINAL = "auto"
# By default disable interactive patch resolution (tasks will just fail instead):
PATCHRESOLVE = "noop"

#
# Disk Space Monitoring during the build
#
# Monitor the disk space during the build. If there is less that 1GB of space or less
# than 100K inodes in any key build location (TMPDIR, DL_DIR, SSTATE_DIR), gracefully
# shutdown the build. If there is less that 100MB or 1K inodes, perform a hard abort
# of the build. The reason for this is that running completely out of space can corrupt
# files and damages the build in ways which may not be easily recoverable.
BB_DISKMON_DIRS = "\
    STOPTASKS,${TMPDIR},1G,100K \
    STOPTASKS,${DL_DIR},1G,100K \
    STOPTASKS,${SSTATE_DIR},1G,100K \
    ABORT,${TMPDIR},100M,1K \
    ABORT,${DL_DIR},100M,1K \
    ABORT,${SSTATE_DIR},100M,1K" 

# CONF_VERSION is increased each time build/conf/ changes incompatibly and is used to
# track the version of this file when it was generated. This can safely be ignored if
# this doesn't mean anything to you.
CONF_VERSION = "1"
```

## meta-resin-common/conf/distro/include/resin-os.inc
```bitbake
# Poky based distro file
require conf/distro/poky.conf
require conf/distro/include/security_flags.inc

DISTRO = "resin-os"
DISTRO_NAME = "Resin OS"
DISTRO_VERSION = "2.18.1"
HOSTOS_VERSION = "${DISTRO_VERSION}"
python () {
    ''' Set HOSTOS_VERSION from board VERSION if available '''

    # Find board VERSION location based on poky meta layer
    bblayers = d.getVar('BBLAYERS', True).split()
    poky = [layer for layer in bblayers if layer.endswith('poky/meta')]
    if not poky:
        return
    board_version_path = os.path.join(poky[0], '../../../', 'VERSION')

    # Set HOSTOS_VERSION
    try:
        with open(board_version_path, 'r') as v:
            board_version = v.read().strip()
        d.setVar('HOSTOS_VERSION', board_version)
    except:
        return
}

MAINTAINER = "Resin <hello@resin.io>"

# Strip down unneeded features
POKY_DEFAULT_DISTRO_FEATURES_remove = "ptest"
POKY_DEFAULT_DISTRO_FEATURES_remove = "wayland"
DISTRO_FEATURES_DEFAULT_remove = "x11"

# Development image mode
DEVELOPMENT_IMAGE ?= "0"
DISTRO_FEATURES_append = " ${@bb.utils.contains('DEVELOPMENT_IMAGE','1','development-image','',d)}"

# Providers
PREFERRED_PROVIDER_docker ?= "docker"
PREFERRED_PROVIDER_jpeg ?= "jpeg"
PREFERRED_PROVIDER_jpeg-native ?= "jpeg-native"

SPLASH = "plymouth"

IMAGE_CLASSES += "image_types_resin"

# Define the URL where resin exposes source or prebuilt packages
AMAZON_RESIN_SHARE = "https://s3.amazonaws.com/resin-share/build_requirements"

# have build information available on the target under /etc/build
INHERIT += "image-buildinfo resin-sanity"

# Identification file flags
RESIN_IMAGE_FLAG_FILE = "resin-image"
RESIN_FLASHER_FLAG_FILE = "resin-image-flasher"

# Initramfs
INITRAMFS_IMAGE = "resin-image-initramfs"
INITRAMFS_IMAGE_BUNDLE = "1"
KERNEL_INITRAMFS = "-initramfs"
INITRAMFS_TASK = ""

# resinOS defaults to ipk packages
PACKAGE_CLASSES ?= "package_ipk"

# Default the docker storage driver to aufs
BALENA_STORAGE ?= "aufs"
python () {
	docker_storage = d.getVar('DOCKER_STORAGE', True)
	if docker_storage:
		d.setVar('BALENA_STORAGE', docker_storage)
}

# Partition fingerprints files
RESIN_FINGERPRINT_EXT ?= "fingerprint"
RESIN_FINGERPRINT_FILENAME ?= "resinos"

# Hostname is generated at runtime based on config.json
hostname_pn-base-files = ""

BAD_RECOMMENDATIONS += "shared-mime-info"
```

## meta-resin-common/conf/distro/include/resin.inc
```bitbake
# Poky based distro file - keep it at the end to be able to overwrite
require conf/distro/poky.conf

DISTRO = "resin"
DISTRO_NAME = "Resin (Yocto Project Resin Distro)"

MAINTAINER = "Resin <hello@resin.io>"

RESIN_DEFAULT_DISTRO_FEATURES = "resin"
RESIN_STAGING_BUILD ?= ""
SUPERVISOR_TAG ?= "production"
DISTRO_FEATURES_append = " ${RESIN_DEFAULT_DISTRO_FEATURES} ${@bb.utils.contains('RESIN_STAGING_BUILD','yes','resin-staging','',d)}"

PREFERRED_PROVIDER_rce ?= "rce-armv6"
PREFERRED_PROVIDER_jpeg ?= "jpeg"
PREFERRED_PROVIDER_jpeg-native ?= "jpeg-native"
PREFERRED_PROVIDER_resin-supervisor ?= "resin-supervisor-disk"

# Use ths resin splash image package
SPLASH = "psplash-resin"

IMAGE_CLASSES += "image_types_resin"

# Define the URL where resin exposes source or prebuilt packages
AMAZON_RESIN_SHARE = "https://s3.amazonaws.com/resin-share/build_requirements"
```

## meta-resin-common/conf/layer.conf
```bitbake
# This layer was deprecated in the favor of meta-balena-common
BALENA_LAYERDIR := "${LAYERDIR}/../meta-balena-common"

BBPATH .= ":${BALENA_LAYERDIR}"

BBFILES += "${BALENA_LAYERDIR}/recipes-*/*/*.bb \
            ${BALENA_LAYERDIR}/recipes-*/*/*.bbappend"

BBFILE_COLLECTIONS += "resin-common"
BBFILE_PATTERN_resin-common := "^${BALENA_LAYERDIR}/"
BBFILE_PRIORITY_resin-common = "1337"

LAYERSERIES_COMPAT_resin-common = "krogoth morty pyro rocko sumo thud warrior"

BALENA_DEPRECATED_YOCTO_LAYER ?= "0"

RESIN_COREBASE := '${@os.path.normpath("${BALENA_LAYERDIR}/")}'

IMAGE_ROOTFS_SIZE ?= "0"
```

## meta-resin-compat/conf/layer.conf
```bitbake
BBPATH .= ":${LAYERDIR}"

BBFILES += "${LAYERDIR}/recipes-*/*/*.bb \
            ${LAYERDIR}/recipes-*/*/*.bbappend"

BBFILE_COLLECTIONS += "resin-compat-layer"
BBFILE_PATTERN_resin-compat-layer := "^${LAYERDIR}/"
BBFILE_PRIORITY_resin-compat-layer = "1337"
```

## meta-resin-daisy/conf/layer.conf
```bitbake
BBPATH .= ":${LAYERDIR}"

BBFILES += "${LAYERDIR}/recipes-*/*/*.bb \
            ${LAYERDIR}/recipes-*/*/*.bbappend"

BBFILE_COLLECTIONS += "resin-daisy"
BBFILE_PATTERN_resin-daisy := "^${LAYERDIR}/"
BBFILE_PRIORITY_resin-daisy  = "1337"
```

## meta-resin-edison/conf/bblayers.conf
```bitbake
# LAYER_CONF_VERSION is increased each time build/conf/bblayers.conf
# changes incompatibly
LCONF_VERSION = "6"

BBPATH = "${TOPDIR}"
BBFILES ?= ""

BBLAYERS ?= " \
  ${TOPDIR}/../poky/meta \
  ${TOPDIR}/../poky/meta-yocto \
  ${TOPDIR}/../poky/meta-yocto-bsp \
  ${TOPDIR}/../meta-resin/meta-resin-edison \
  ${TOPDIR}/../meta-resin/meta-resin-common \
  ${TOPDIR}/../edison-src/meta-intel-edison/meta-intel-edison-bsp \
  ${TOPDIR}/../edison-src/meta-intel-edison/meta-intel-edison-distro \
  ${TOPDIR}/../edison-src/meta-intel-edison/meta-intel-arduino \
  ${TOPDIR}/../meta-intel-iot-middleware \
  ${TOPDIR}/../meta-openembedded/meta-oe \
  ${TOPDIR}/../meta-openembedded/meta-networking \
  \
  "

BBLAYERS_NON_REMOVABLE ?= " \
  ${TOPDIR}/../poky/meta \
  ${TOPDIR}/../poky/meta-yocto \
  "
```

## meta-resin-edison/conf/layer.conf
```bitbake
BBPATH .= ":${LAYERDIR}"

BBFILES += "${LAYERDIR}/recipes-*/*/*.bb \
            ${LAYERDIR}/recipes-*/*/*.bbappend"

BBFILE_COLLECTIONS += "resin-edison"
BBFILE_PATTERN_resin-edison := "^${LAYERDIR}/"
BBFILE_PRIORITY_resin-edison = "1337"

PREFERRED_PROVIDER_virtual/kernel_edison ?= "linux-yocto"
PREFERRED_VERSION_linux-yocto_edison = "3.10%"
PREFERRED_PROVIDER_virtual/bootloader_edison ?=  "u-boot"
PREFERRED_VERSION_u-boot_edison ?= "2014.04-1"
PREFERRED_VERSION_u-boot-fw-utils_edison ?= "2014.04-1"
PREFERRED_VERSION_connman_edison ?= "1.27"
PREFERRED_VERSION_openssl_edison ?= "1.0.1m"
PREFERRED_VERSION_systemd_edison ?= "213+gitAUTOINC+c9679c652b"

# Edison uses a sepcial fs-perms file
FILESYSTEM_PERMS_TABLES_edison = "${TOPDIR}/../edison-src/device-software/meta-edison-distro/files/fs-perms.txt"
```

## meta-resin-fido/conf/layer.conf
```bitbake
BBPATH .= ":${LAYERDIR}"

BBFILES += "${LAYERDIR}/recipes-*/*/*.bb \
            ${LAYERDIR}/recipes-*/*/*.bbappend"

BBFILE_COLLECTIONS += "resin-fido"
BBFILE_PATTERN_resin-fido := "^${LAYERDIR}/"
BBFILE_PRIORITY_resin-fido = "1337"
```

## meta-resin-fsl-arm/conf/layer.conf
```bitbake
BBPATH .= ":${LAYERDIR}"

BBFILES += "${LAYERDIR}/recipes-*/*/*.bb \
            ${LAYERDIR}/recipes-*/*/*.bbappend"

BBFILE_COLLECTIONS += "resin-fsl-arm"
BBFILE_PATTERN_resin-fsl-arm := "^${LAYERDIR}/"
BBFILE_PRIORITY_resin-fsl-arm = "1337"
```
